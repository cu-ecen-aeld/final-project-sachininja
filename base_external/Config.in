## base_external/Config.in
```kconfig
source "$BR2_EXTERNAL_assignment_base_PATH/package/i2s_package/Config.in"
source "$BR2_EXTERNAL_assignment_base_PATH/package/bluetooth_server/Config.in" 
```

## base_external/package/aesd-chardriver/Config.in
```kconfig
config BR2_PACKAGE_AESD_ASSIGNMENTS
	bool "aesd-chardriver"
	help
	  Circular buffer based driver implementation
```

## base_external/package/bluetooth_server/Config.in
```kconfig
config BR2_PACKAGE_BLUETOOTH_SERVER
	bool "bluetooth_server"
	help
	  Includes the related conf files required for bluetooth server bring up on buildroot.
```

## base_external/package/i2s_package/Config.in
```kconfig
config BR2_PACKAGE_I2S_PACKAGE
	bool "i2s-package"
	help
	  Includes the related conf files required for i2s bring up on buildroot.
```
